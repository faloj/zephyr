## drivers/rtc/Kconfig.stm32
```kconfig
# ST STM32 RTC

# Copyright (c) 2023 Syslinbit
# SPDX-License-Identifier: Apache-2.0

config RTC_STM32
	bool "STM32 RTC driver"
	default y if !COUNTER_RTC_STM32
	depends on DT_HAS_ST_STM32_RTC_ENABLED
	help
	  Enable the STM32 RTC driver.
```
